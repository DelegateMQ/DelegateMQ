## example/pumptron/controller/platform/esp32s3/main/Kconfig.projbuild
```kconfig
menu "Pumptron"

    config APP_WIFI_SSID
        string "Wi-Fi SSID"
        default ""
        help
            The network the controller joins (2.4 GHz). Set it here, not in
            sdkconfig.defaults: the generated sdkconfig.esp32s3 that holds it
            isn't committed.

    config APP_WIFI_PASSWORD
        string "Wi-Fi password"
        default ""
        help
            Empty for an open network.

    config APP_GUI_ADDRESS
        string "PC (pumptron_gui) IPv4 address"
        default "192.168.0.100"
        help
            Where the controller sends status and telemetry (UDP port 5020).
            Run "pumptron_gui --udp <the board's address>" there; the board
            prints its address at startup.

    config APP_SPY
        bool "Send DataBus traffic to dmq-spy"
        default y
        help
            Every message on the controller's DataBus goes to dmq-spy on the
            PC (APP_GUI_ADDRESS, port APP_SPY_PORT), as sender "Controller",
            with the board's own timestamps (DelegateMQ's SpyReporter).

    config APP_SPY_PORT
        int "dmq-spy UDP port"
        default 9999
        depends on APP_SPY

    config APP_MONITOR
        bool "Report to dmq-monitor and dmq-thread"
        default y
        help
            The controller's heartbeat, link health and threads (Pump, the
            link, the reporters) go to dmq-monitor and dmq-thread on the PC
            (DelegateMQ's NodeReporter), to the multicast group both listen
            on.

    config APP_MONITOR_GROUP
        string "dmq-monitor / dmq-thread multicast group"
        default "239.1.1.1"
        depends on APP_MONITOR

    config APP_MONITOR_PORT
        int "dmq-monitor / dmq-thread UDP port"
        default 9998
        depends on APP_MONITOR

    config APP_LED_GPIO
        int "RGB LED (WS2812) GPIO"
        default 38
        help
            GPIO 38 on DevKitC-1 v1.1, GPIO 48 on v1.0.

    config APP_BUTTON_GPIO
        int "Local E-STOP button GPIO"
        default 0
        help
            The BOOT button (GPIO 0, low when pressed).

endmenu
```

## example/sample-projects/boards/esp32s3-devkitc/main/Kconfig.projbuild
```kconfig
menu "ESP32-S3-DevKitC sample"

    config APP_LED_GPIO
        int "RGB LED (WS2812) GPIO"
        default 38
        help
            The board's addressable RGB LED: GPIO 48 on DevKitC-1 v1.0, GPIO 38 on
            v1.1. The board version is printed on the board.

    config APP_BUTTON_GPIO
        int "Button GPIO"
        default 0
        help
            The BOOT button (GPIO 0, low when pressed).

endmenu
```

## example/sensor-node/node/platform/esp32s3/main/Kconfig.projbuild
```kconfig
menu "Sensor node"

    config APP_WIFI_SSID
        string "Wi-Fi SSID"
        default ""
        help
            The network the node joins (2.4 GHz). Set it here, not in
            sdkconfig.defaults: the generated sdkconfig.esp32s3 that holds it
            isn't committed.

    config APP_WIFI_PASSWORD
        string "Wi-Fi password"
        default ""
        help
            Empty for an open network.

    config APP_PC_ADDRESS
        string "PC client's IPv4 address"
        default "192.168.0.100"
        help
            Where the node publishes its data (UDP port 9100). Run sensor_pc
            there, with the node's address (printed at startup) as its second
            argument.

    config APP_LED_GPIO
        int "RGB LED (WS2812) GPIO"
        default 38
        help
            GPIO 38 on DevKitC-1 v1.1, GPIO 48 on v1.0.

    config APP_BUTTON_GPIO
        int "Touch stand-in button GPIO"
        default 0
        help
            The BOOT button (GPIO 0, low when pressed). Its presses and
            releases are the node's touch events (pad 0).

endmenu
```
